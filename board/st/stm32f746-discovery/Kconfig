## board/st/stm32f746-discovery/Kconfig
```kconfig
if TARGET_STM32F746_DISCOVERY

config SYS_BOARD
	string
	default "stm32f746-discovery"

config SYS_VENDOR
	string
	default "st"

config SYS_SOC
	string
	default "stm32f7"

config SYS_CONFIG_NAME
	string
	default "stm32f746-discovery"

endif
```
